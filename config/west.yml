## config/west.yml
```yaml
manifest:
  remotes:
    - name: zmkfirmware
      url-base: https://github.com/zmkfirmware
    - name: infused-kim
      url-base: https://github.com/infused-kim
    - name: petejohanson
      url-base: https://github.com/petejohanson
    - name: urob
      url-base: https://github.com/urob
    - name: badjeff
      url-base: https://github.com/badjeff/
    - name: dhruvinsh
      url-base: https://github.com/dhruvinsh

  projects:

    - name: zmk
      remote: infused-kim
      revision: pr-testing/mouse_ps2_module_base
      import: app/west.yml

    # Module for PS/2 mouse & TP driver
    - name: kb_zmk_ps2_mouse_trackpoint_driver
      remote: infused-kim
      revision: dev/2024-04-acceleration

    # zmk module for nice_peri_view
    - name: tmp-npv
      remote: infused-kim
      revision: main

    # Urob's zmk helpers that contain key position defines
    - name: zmk-helpers
      remote: urob
      revision: v2 # this will eventually become main

    # Tri-state behavior to make cmd+tab switching key
    # Used to be a key feature in urob's fork
    - name: zmk-tri-state
      remote: dhruvinsh
      revision: main

  self:
    path: config
```
